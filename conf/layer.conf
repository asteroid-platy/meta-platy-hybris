## conf/layer.conf
```bitbake
BBPATH .= ":${LAYERDIR}"
BBFILES += "${LAYERDIR}/recipes*/*/*.bb ${LAYERDIR}/recipes*/*/*.bbappend"
BBFILE_COLLECTIONS += "platy-hybris-layer"
BBFILE_PATTERN_platy-hybris-layer := "^${LAYERDIR}/"
BBFILE_PRIORITY_platy-hybris-layer = "8"
LAYERSERIES_COMPAT_platy-hybris-layer = "sumo"
```

## conf/machine/platy.conf
```bitbake
#@TYPE: Machine
#@NAME: ZTE Quartz
#@DESCRIPTION: Machine configuration for the ZTE Quartz

require conf/machine/include/tune-cortexa7.inc
require conf/machine/include/hybris-watch.inc

PREFERRED_VERSION_android = "nougat"

PREFERRED_PROVIDER_virtual/kernel = "linux-platy"
PREFERRED_VERSION_linux = "3.18+nougat"

IMAGE_INSTALL += "msm-fb-refresher"
```
